## firmware/zmk/Kconfig
```kconfig
config ZMK_KEYLAY
    bool "Report the active layer and battery levels to the KeyLay app over Bluetooth"
    default y
    depends on ZMK_BLE
    depends on !ZMK_SPLIT || ZMK_SPLIT_ROLE_CENTRAL
    help
      Adds a GATT service whose characteristic holds the active layer and the battery
      levels, and notifies the host when they change. See firmware/PROTOCOL.md in KeyLay.
```
